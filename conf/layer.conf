## conf/layer.conf
```bitbake
# We have a conf and classes directory, add to BBPATH
BBPATH .= ":${LAYERDIR}"

# We have recipes-* directories, add to BBFILES
BBFILES += "${LAYERDIR}/recipes-*/*/*.bb \
            ${LAYERDIR}/recipes-*/*/*.bbappend"

BBFILE_COLLECTIONS += "meta-esquenta-yocto"
BBFILE_PATTERN_meta-esquenta-yocto = "^${LAYERDIR}/"
BBFILE_PRIORITY_meta-esquenta-yocto = "6"

LAYERDEPENDS_meta-esquenta-yocto = "core"
LAYERSERIES_COMPAT_meta-esquenta-yocto = "dunfell"
```
